## conf/layer.conf
```bitbake
# We have a conf directory, append to BBPATH
BBPATH .= ":${LAYERDIR}"

# We have a recipes directory, add to BBFILES
BBFILES += "${LAYERDIR}/recipes-*/*/*.bb ${LAYERDIR}/recipes-*/*/*.bbappend"

BBFILE_COLLECTIONS += "legrand-devkit"
BBFILE_PATTERN_legrand-devkit := "^${LAYERDIR}/"

BBFILE_PRIORITY_legrand-devkit = "1"
```
